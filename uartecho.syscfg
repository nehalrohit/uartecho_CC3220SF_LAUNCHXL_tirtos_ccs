/**
 * @cliArgs --board "/ti/boards/CC3220SF_LAUNCHXL" --product "simplelink_cc32xx_sdk@4_20_00_07"
 * @versions {"data":"2020052512","timestamp":"2020052512","tool":"1.5.0+1397","templates":"2020052512"}
 */

/**
 * Import the modules used in this configuration.
 */
const ADC    = scripting.addModule("/ti/drivers/ADC", {}, false);
const ADC1   = ADC.addInstance();
const GPIO   = scripting.addModule("/ti/drivers/GPIO");
const GPIO1  = GPIO.addInstance();
const GPIO2  = GPIO.addInstance();
const GPIO3  = GPIO.addInstance();
const GPIO4  = GPIO.addInstance();
const GPIO5  = GPIO.addInstance();
const I2C    = scripting.addModule("/ti/drivers/I2C", {}, false);
const I2C1   = I2C.addInstance();
const PWM    = scripting.addModule("/ti/drivers/PWM", {}, false);
const PWM1   = PWM.addInstance();
const PWM2   = PWM.addInstance();
const RTOS   = scripting.addModule("/ti/drivers/RTOS");
const SPI    = scripting.addModule("/ti/drivers/SPI");
const SPI1   = SPI.addInstance();
const Timer  = scripting.addModule("/ti/drivers/Timer", {}, false);
const Timer1 = Timer.addInstance();
const Timer2 = Timer.addInstance();
const Timer3 = Timer.addInstance();
const UART   = scripting.addModule("/ti/drivers/UART");
const UART1  = UART.addInstance();
const UART2  = scripting.addModule("/ti/drivers/UART2", {}, false);
const UART21 = UART2.addInstance();

/**
 * Write custom configuration values to the imported modules.
 */
ADC1.$name              = "CONFIG_ADC_0";
ADC1.adc.adcPin.$assign = "boosterpack.26";

GPIO1.$name              = "Alert_GPIO";
GPIO1.initialOutputState = "High";
GPIO1.pull               = "Pull Up";
GPIO1.interruptTrigger   = "Falling Edge";
GPIO1.mode               = "Dynamic";
GPIO1.gpioPin.$assign    = "boosterpack.27";

GPIO2.$name           = "CONFIG_GPIO_ss";
GPIO2.mode            = "Output";
GPIO2.gpioPin.$assign = "boosterpack.19";

GPIO3.$name = "CONFIG_IN2";
GPIO3.mode  = "Output";

GPIO4.$name = "CONFIG_GPIO_nsleep";
GPIO4.mode  = "Output";

GPIO5.$name = "CONFIG_GPIO_fault";

I2C1.$name              = "CONFIG_I2C_TMP";
I2C1.$hardware          = system.deviceData.board.components.LP_I2C;
I2C1.i2c.$assign        = "I2C0";
I2C1.i2c.sdaPin.$assign = "boosterpack.10";
I2C1.i2c.sclPin.$assign = "boosterpack.9";

PWM1.$name                = "CONFIG_PWM_1";
PWM1.timer.pwmPin.$assign = "boosterpack.13";

PWM2.$name     = "CONFIG_PWM_Buzzer";
PWM2.$hardware = system.deviceData.board.components.LED_RED;

const Power          = scripting.addModule("/ti/drivers/Power", {}, false);
Power.parkPins.$name = "ti_drivers_power_PowerCC32XXPins0";

SPI1.$name     = "CONFIG_SPI_0";
SPI1.ssControl = "SW";

Timer1.$name     = "CONFIG_TIMER_0";
Timer1.timerType = "32 Bits";

Timer2.$name = "CONFIG_TIMER_1";

Timer3.$name = "CONFIG_TIMER_2";

UART1.$name             = "CONFIG_UART_0";
UART1.$hardware         = system.deviceData.board.components.XDS110UART;
UART1.interruptPriority = "3";
UART1.ringBufferSize    = 64;

UART21.$name              = "CONFIG_UART2_0";
UART21.uart.txPin.$assign = "boosterpack.8";

/**
 * Pinmux solution for unlocked pins/peripherals. This ensures that minor changes to the automatic solver in a future
 * version of the tool will not impact the pinmux you originally saw.  These lines can be completely deleted in order to
 * re-solve from scratch.
 */
ADC1.adc.$suggestSolution                 = "ADC0";
GPIO3.gpioPin.$suggestSolution            = "boosterpack.4";
GPIO4.gpioPin.$suggestSolution            = "boosterpack.18";
GPIO5.gpioPin.$suggestSolution            = "boosterpack.30";
PWM1.timer.$suggestSolution               = "Timer1";
PWM2.timer.$suggestSolution               = "Timer2";
PWM2.timer.pwmPin.$suggestSolution        = "boosterpack.29";
SPI1.spi.$suggestSolution                 = "SPI0";
SPI1.spi.sclkPin.$suggestSolution         = "boosterpack.7";
SPI1.spi.misoPin.$suggestSolution         = "boosterpack.14";
SPI1.spi.mosiPin.$suggestSolution         = "boosterpack.15";
SPI1.spi.dmaRxChannel.$suggestSolution    = "UDMA_CH30";
SPI1.spi.dmaTxChannel.$suggestSolution    = "UDMA_CH31";
Timer1.timer.$suggestSolution             = "Timer3";
Timer2.timer.$suggestSolution             = "Timer0";
Timer3.timer.$suggestSolution             = "Timer0";
UART1.uart.$suggestSolution               = "UART1";
UART1.uart.txPin.$suggestSolution         = "GP01";
UART1.uart.rxPin.$suggestSolution         = "GP02";
UART21.uart.$suggestSolution              = "UART0";
UART21.uart.txDmaChannel.$suggestSolution = "UDMA_CH9";
UART21.uart.rxPin.$suggestSolution        = "boosterpack.17";
UART21.uart.rxDmaChannel.$suggestSolution = "UDMA_CH8";
